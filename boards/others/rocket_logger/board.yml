## boards/others/rocket_logger/board.yml
```yaml
board:
  name: rocket_logger
  vendor: others
  socs:
    - name: stm32f103xb
  
```

## boards/others/rocket_logger/rocket_logger_defconfig
```kconfig
# enable GPIO
CONFIG_GPIO=y

# enable clock control
CONFIG_CLOCK_CONTROL=y

# enable pin controller
CONFIG_PINCTRL=y
```
